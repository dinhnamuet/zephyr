## boards/saoviet/wm_nb_iotv8_5/Kconfig
```kconfig
# Copyright (c) 2021 Matija Tudan
# SPDX-License-Identifier: Apache-2.0

config BOARD_WM_NB_IOTV8_5
	select SOC_STM32L433XX
```

## boards/saoviet/wm_nb_iotv8_5/Kconfig.defconfig
```kconfig
# WM_NB_IOTV8_5 Board configuration

# Copyright (c) 2021 Matija Tudan
# SPDX-License-Identifier: Apache-2.0

if BOARD_WM_NB_IOTV8_5

config SPI_STM32_INTERRUPT
	default y
	depends on SPI

endif # BOARD_WM_NB_IOTV8_5
```

## boards/saoviet/wm_nb_iotv8_5/board.yml
```yaml
board:
  name: wm_nb_iotv8_5
  full_name: WM NB IoT V8.5
  vendor: saoviet
  socs:
    - name: stm32l433xx
```
